/dts-v1/;

/ {
	compatible = "brcm,bcm2835";

	fragment@0 {
		target = <0xffffffff>;

		__overlay__ {
			brcm,pins = <0x08 0x07>;
			phandle = <0x01>;
		};
	};

	fragment@1 {
		target = <0xffffffff>;

		__overlay__ {
			cs-gpios = <0xffffffff 0x08 0x01 0xffffffff 0x07 0x01>;
			status = "okay";
			phandle = <0x02>;
		};
	};

	fragment@2 {
		target = <0xffffffff>;

		__dormant__ {
			brcm,pins = <0x0a 0x0b>;
		};
	};

	__overrides__ {
		cs0_pin = [00 00 00 01 62 72 63 6d 2c 70 69 6e 73 3a 30 00 00 00 00 02 63 73 2d 67 70 69 6f 73 3a 34 00];
		cs1_pin = <0x01 0x6272636d 0x2c70696e 0x733a3400 0x02 0x63732d67 0x70696f73 0x3a313600>;
		no_miso = [00 00 00 00 3d 32 00];
	};

	__symbols__ {
		frag0 = "/fragment@0/__overlay__";
		frag1 = "/fragment@1/__overlay__";
	};

	__fixups__ {
		spi0_cs_pins = "/fragment@0:target:0";
		spi0 = "/fragment@1:target:0";
		gpio = "/fragment@1/__overlay__:cs-gpios:0", "/fragment@1/__overlay__:cs-gpios:12";
		spi0_pins = "/fragment@2:target:0";
	};

	__local_fixups__ {

		__overrides__ {
			cs0_pin = <0x00 0x10>;
			cs1_pin = <0x00 0x10>;
		};
	};
};
